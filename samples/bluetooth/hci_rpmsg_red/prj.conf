## CMakeLists.txt
```
# SPDX-License-Identifier: Apache-2.0

cmake_minimum_required(VERSION 3.13.1)

find_package(Zephyr REQUIRED)

project(red_nrf53_net)

add_subdirectory(src)
```

## Kconfig
```
module=RED_NETWORK
source "${ZEPHYR_NRF_MODULE_DIR}/subsys/partition_manager/Kconfig.template.build_strategy"

# Include Zephyr's Kconfig.
source "$ZEPHYR_BASE/Kconfig"
```

## prj.conf
```kconfig
CONFIG_HEAP_MEM_POOL_SIZE=3000

CONFIG_TINYCBOR=y
CONFIG_THREAD_CUSTOM_DATA=y
CONFIG_ENTROPY_GENERATOR=y

CONFIG_RPMSG_SERVICE=y
CONFIG_RPMSG_SERVICE_MODE_REMOTE=y

CONFIG_NRF_RPC=y
CONFIG_NRF_RPC_CBOR=y
CONFIG_NRF_RPC_THREAD_STACK_SIZE=4096

CONFIG_LOG=n

CONFIG_DYNAMIC_INTERRUPTS=y
CONFIG_NRFX_TIMER0=y

CONFIG_MAIN_STACK_SIZE=1024
CONFIG_SYSTEM_WORKQUEUE_STACK_SIZE=1024
CONFIG_BT=y
CONFIG_BT_HCI_RAW=y
CONFIG_BT_MAX_CONN=2
CONFIG_BT_CTLR_ASSERT_HANDLER=y
CONFIG_BT_HCI_RAW_RESERVE=1

# Workaround: Unable to allocate command buffer when using K_NO_WAIT since
# Host number of completed commands does not follow normal flow control.
CONFIG_BT_BUF_CMD_TX_COUNT=4

CONFIG_SERIAL=n
CONFIG_UART_CONSOLE=n
```

## src/main.c
```c
/**
 * @file main..c
 * @author Giuliano FRANCHETTO
 * @date 15 November 2021
 * 
 * @copyright @verbatim
 * Intellinium SAS, 2014-present
 * All Rights Reserved.
 *
 * NOTICE:  All information contained herein is, and remains
 * the property of Intellinium SAS and its suppliers,
 * if any.  The intellectual and technical concepts contained
 * herein are proprietary to Intellinium SAS
 * and its suppliers and may be covered by French and Foreign Patents,
 * patents in process, and are protected by trade secret or copyright law.
 * Dissemination of this information or reproduction of this material
 * is strictly forbidden unless prior written permission is obtained
 * from Intellinium SAS.
 * @endverbatim
 * 
 * @brief 
 **/

#include <errno.h>
#include <init.h>

#include <tinycbor/cbor.h>
#include <nrf_rpc_cbor.h>

#include "radio_test.h"

#include "common_ids.h"
#include "bt_hci_rpmsg.h"

/* @formatter:off*/
#define BLE_RPC_DECODER(cmd, cb, var)					       \
	NRF_RPC_CBOR_CMD_DECODER(ble_group, cmd, cmd, cb, var)
/* @formatter:on*/

/* Radio parameter configuration. */
static struct radio_param_config {
	/** Radio transmission pattern. */
	enum transmit_pattern tx_pattern;

	/** Radio mode. Data rate and modulation. */
	nrf_radio_mode_t mode;

	/** Radio output power. */
	uint8_t txpower;

	/** Radio start channel (frequency). */
	uint8_t channel_start;

	/** Radio end channel (frequency). */
	uint8_t channel_end;

	/** Delay time in milliseconds. */
	uint32_t delay_ms;

	/** Duty cycle. */
	uint32_t duty_cycle;
} config = {
	.tx_pattern = TRANSMIT_PATTERN_RANDOM,
	.mode = NRF_RADIO_MODE_BLE_1MBIT,
	.txpower = RADIO_TXPOWER_TXPOWER_0dBm,
	.channel_start = 0,
	.channel_end = 80,
	.delay_ms = 10,
	.duty_cycle = 50,
};

static bool test_in_progress;
static struct radio_test_config test_config;

NRF_RPC_GROUP_DEFINE(ble_group, "nrf_ble_radio", NULL, NULL, NULL);

static void rsp_error_code_send(int err_code)
{
	struct nrf_rpc_cbor_ctx ctx;

	NRF_RPC_CBOR_ALLOC(ctx, 16);

	cbor_encode_int(&ctx.encoder, err_code);

	nrf_rpc_cbor_rsp_no_err(&ctx);
}

static void ble_tx_power(CborValue *packet, void *handler_data)
{
	ARG_UNUSED(handler_data);

	int tx;
	CborError cbor_err;

	cbor_err = cbor_value_get_int(packet, &tx);
	nrf_rpc_cbor_decoding_done(packet);

	if (cbor_err != CborNoError || tx < 0) {
		rsp_error_code_send(-NRF_EBADMSG);
		return;
	}

	config.txpower = tx;
	rsp_error_code_send(0);
}
BLE_RPC_DECODER(RPC_COMMAND_TX_POWER, ble_tx_power, NULL);

static void ble_tx_pattern(CborValue *packet, void *handler_data)
{
	ARG_UNUSED(handler_data);

	int pattern;
	CborError cbor_err;

	cbor_err = cbor_value_get_int(packet, &pattern);
	nrf_rpc_cbor_decoding_done(packet);

	if (cbor_err != CborNoError || pattern < 0) {
		rsp_error_code_send(-NRF_EBADMSG);
		return;
	}

	config.tx_pattern = pattern;
	rsp_error_code_send(0);
}
BLE_RPC_DECODER(RPC_COMMAND_TRANSMIT_PATTERN, ble_tx_pattern, NULL);

static void ble_start_channel(CborValue *packet, void *handler_data)
{
	ARG_UNUSED(handler_data);

	int channel;
	CborError cbor_err;

	cbor_err = cbor_value_get_int(packet, &channel);
	nrf_rpc_cbor_decoding_done(packet);

	if (cbor_err != CborNoError || channel < 0 || channel > 80) {
		rsp_error_code_send(-NRF_EBADMSG);
		return;
	}

	config.channel_start = channel;
	rsp_error_code_send(0);
}
BLE_RPC_DECODER(RPC_COMMAND_START_CHANNEL, ble_start_channel, NULL);

static void ble_end_channel(CborValue *packet, void *handler_data)
{
	ARG_UNUSED(handler_data);

	int channel;
	CborError cbor_err;

	cbor_err = cbor_value_get_int(packet, &channel);
	nrf_rpc_cbor_decoding_done(packet);

	if (cbor_err != CborNoError || channel < 0 || channel > 80) {
		rsp_error_code_send(-NRF_EBADMSG);
		return;
	}

	config.channel_end = channel;
	rsp_error_code_send(0);
}
BLE_RPC_DECODER(RPC_COMMAND_END_CHANNEL, ble_end_channel, NULL);

static void ble_time_on_channel(CborValue *packet, void *handler_data)
{
	ARG_UNUSED(handler_data);

	int time;
	CborError cbor_err;

	cbor_err = cbor_value_get_int(packet, &time);
	nrf_rpc_cbor_decoding_done(packet);

	if (cbor_err != CborNoError || time < 0 || time > 99) {
		rsp_error_code_send(-NRF_EBADMSG);
		return;
	}

	config.delay_ms = time;
	rsp_error_code_send(0);
}
BLE_RPC_DECODER(RPC_COMMAND_TIME_ON_CHANNEL, ble_time_on_channel, NULL);

static void ble_cancel(CborValue *packet, void *handler_data)
{
	ARG_UNUSED(handler_data);

	nrf_rpc_cbor_decoding_done(packet);

	radio_test_cancel();
	rsp_error_code_send(0);
}
BLE_RPC_DECODER(RPC_COMMAND_CANCEL, ble_cancel, NULL);

static void ble_datarate(CborValue *packet, void *handler_data)
{
	ARG_UNUSED(handler_data);

	int data_rate;
	CborError cbor_err;

	cbor_err = cbor_value_get_int(packet, &data_rate);
	nrf_rpc_cbor_decoding_done(packet);

	if (cbor_err != CborNoError) {
		rsp_error_code_send(-NRF_EBADMSG);
		return;
	}

	config.mode = data_rate;
	rsp_error_code_send(0);
}
BLE_RPC_DECODER(RPC_COMMAND_DATA_RATE, ble_datarate, NULL);

static void ble_tx_carrier(CborValue *packet, void *handler_data)
{
	ARG_UNUSED(handler_data);

	nrf_rpc_cbor_decoding_done(packet);

	if (test_in_progress) {
		radio_test_cancel();
		test_in_progress = false;
	}

	memset(&test_config, 0, sizeof(test_config));
	test_config.type = UNMODULATED_TX;
	test_config.mode = config.mode;
	test_config.params.unmodulated_tx.txpower = config.txpower;
	test_config.params.unmodulated_tx.channel = config.channel_start;

	radio_test_start(&test_config);

	rsp_error_code_send(0);
}
BLE_RPC_DECODER(RPC_COMMAND_START_TX_CARRIER, ble_tx_carrier, NULL);

static void tx_modulated_carrier_end(void)
{
	printk("The modulated TX has finished\n");
}

static void ble_start_tx_mod_carrier(CborValue *packet, void *handler_data)
{
	ARG_UNUSED(handler_data);

	int qty;
	CborError cbor_err;

	cbor_err = cbor_value_get_int(packet, &qty);
	nrf_rpc_cbor_decoding_done(packet);

	if (test_in_progress) {
		radio_test_cancel();
		test_in_progress = false;
	}

	memset(&test_config, 0, sizeof(test_config));
	test_config.type = UNMODULATED_TX;
	test_config.mode = config.mode;
	test_config.params.unmodulated_tx.txpower = config.txpower;
	test_config.params.unmodulated_tx.channel = config.channel_start;

	if (cbor_err == CborNoError) {
		test_config.params.modulated_tx.packets_num = qty;
		test_config.params.modulated_tx.cb = tx_modulated_carrier_end;
	}

	radio_test_start(&test_config);

	rsp_error_code_send(0);
}
BLE_RPC_DECODER(RPC_COMMAND_START_TX_MOD_CARRIER, ble_start_tx_mod_carrier,
		NULL);

static void ble_start_tx_dc_mod_carrier(CborValue *packet, void *handler_data)
{
	ARG_UNUSED(handler_data);

	int dc;
	CborError cbor_err;

	cbor_err = cbor_value_get_int(packet, &dc);
	nrf_rpc_cbor_decoding_done(packet);

	if (cbor_err != CborNoError || dc < 0 || dc > 100) {
		rsp_error_code_send(-NRF_EBADMSG);
		return;
	}

	config.duty_cycle = dc;
	memset(&test_config, 0, sizeof(test_config));
	test_config.type = MODULATED_TX_DUTY_CYCLE;
	test_config.mode = config.mode;
	test_config.params.modulated_tx_duty_cycle.txpower = config.txpower;
	test_config.params.modulated_tx_duty_cycle.pattern = config.tx_pattern;
	test_config.params.modulated_tx_duty_cycle.channel =
		config.channel_start;
	test_config.params.modulated_tx_duty_cycle.duty_cycle =
		config.duty_cycle;

	radio_test_start(&test_config);
	test_in_progress = true;
	rsp_error_code_send(0);
}
BLE_RPC_DECODER(RPC_COMMAND_START_TX_DC_MOD_CARRIER,
		ble_start_tx_dc_mod_carrier, NULL);

static void ble_start_rx_sweep(CborValue *packet, void *handler_data)
{
	ARG_UNUSED(handler_data);

	nrf_rpc_cbor_decoding_done(packet);

	memset(&test_config, 0, sizeof(test_config));
	test_config.type = RX_SWEEP;
	test_config.mode = config.mode;
	test_config.params.rx_sweep.channel_start = config.channel_start;
	test_config.params.rx_sweep.channel_end = config.channel_end;
	test_config.params.rx_sweep.delay_ms = config.delay_ms;

	radio_test_start(&test_config);

	test_in_progress = true;
	rsp_error_code_send(0);
}
BLE_RPC_DECODER(RPC_COMMAND_START_RX_SWEEP, ble_start_rx_sweep, NULL);

static void ble_start_tx_sweep(CborValue *packet, void *handler_data)
{
	ARG_UNUSED(handler_data);

	nrf_rpc_cbor_decoding_done(packet);

	memset(&test_config, 0, sizeof(test_config));
	test_config.type = TX_SWEEP;
	test_config.mode = config.mode;
	test_config.params.tx_sweep.channel_start = config.channel_start;
	test_config.params.tx_sweep.channel_end = config.channel_end;
	test_config.params.tx_sweep.delay_ms = config.delay_ms;
	test_config.params.tx_sweep.txpower = config.txpower;

	radio_test_start(&test_config);

	test_in_progress = true;
	rsp_error_code_send(0);
}
BLE_RPC_DECODER(RPC_COMMAND_START_TX_SWEEP, ble_start_tx_sweep, NULL);

static void ble_start_rx(CborValue *packet, void *handler_data)
{
	ARG_UNUSED(handler_data);

	if (test_in_progress) {
		radio_test_cancel();
		test_in_progress = false;
	}

	nrf_rpc_cbor_decoding_done(packet);

	memset(&test_config, 0, sizeof(test_config));
	test_config.type = RX;
	test_config.mode = config.mode;
	test_config.params.rx.channel = config.channel_start;
	test_config.params.rx.pattern = config.tx_pattern;

	radio_test_start(&test_config);

	test_in_progress = true;
	rsp_error_code_send(0);
}
BLE_RPC_DECODER(RPC_COMMAND_START_RX, ble_start_rx, NULL);

static void err_handler(const struct nrf_rpc_err_report *report)
{
	printk("nRF RPC error %d occurred."
	       "See nRF RPC logs for more details.",
	       report->code);
	k_oops();
}

#include <drivers/clock_control.h>
#include <drivers/clock_control/nrf_clock_control.h>
static void clock_init(void)
{
	int err;
	int res;
	struct onoff_manager *clk_mgr;
	struct onoff_client clk_cli;

	clk_mgr = z_nrf_clock_control_get_onoff(CLOCK_CONTROL_NRF_SUBSYS_HF);
	if (!clk_mgr) {
		printk("Unable to get the Clock manager\n");
		return;
	}

	sys_notify_init_spinwait(&clk_cli.notify);

	err = onoff_request(clk_mgr, &clk_cli);
	if (err < 0) {
		printk("Clock request failed: %d\n", err);
		return;
	}

	do {
		err = sys_notify_fetch_result(&clk_cli.notify, &res);
		if (!err && res) {
			printk("Clock could not be started: %d\n", res);
			return;
		}
	} while (err);

	printk("Clock has started\n");
}

int main(void)
{
	int err;

	printk("Init begin\n");

	clock_init();

	err = nrf_rpc_init(err_handler);
	if (err) {
		return -NRF_EINVAL;
	}

	radio_test_init(&test_config);

	printk("Init done\n");

	bt_hci_rpmsg_loop();

	return 0;
}
```

## src/bt_hci_rpmsg.c
```c
/*
 * Copyright (c) 2019-2021 Nordic Semiconductor ASA
 *
 * SPDX-License-Identifier: Apache-2.0
 */

#include <errno.h>
#include <stddef.h>
#include <stdio.h>

#include <zephyr.h>
#include <arch/cpu.h>
#include <sys/byteorder.h>
#include <sys/util.h>
#include <drivers/ipm.h>

#include <openamp/open_amp.h>

#include <ipc/rpmsg_service.h>

#include <net/buf.h>
#include <bluetooth/hci.h>
#include <bluetooth/buf.h>
#include <bluetooth/hci_raw.h>

#define BT_DBG_ENABLED 0
#define LOG_MODULE_NAME hci_rpmsg
#include "common/log.h"

static int endpoint_id;

static K_THREAD_STACK_DEFINE(tx_thread_stack, CONFIG_BT_HCI_TX_STACK_SIZE);
static struct k_thread tx_thread_data;
static K_FIFO_DEFINE(tx_queue);

#define HCI_RPMSG_CMD 0x01
#define HCI_RPMSG_ACL 0x02
#define HCI_RPMSG_SCO 0x03
#define HCI_RPMSG_EVT 0x04
#define HCI_RPMSG_ISO 0x05

static struct net_buf *hci_rpmsg_cmd_recv(uint8_t *data, size_t remaining)
{
	struct bt_hci_cmd_hdr *hdr = (void *)data;
	struct net_buf *buf;

	if (remaining < sizeof(*hdr)) {
		LOG_ERR("Not enought data for command header");
		return NULL;
	}

	buf = bt_buf_get_tx(BT_BUF_CMD, K_NO_WAIT, hdr, sizeof(*hdr));
	if (buf) {
		data += sizeof(*hdr);
		remaining -= sizeof(*hdr);
	} else {
		LOG_ERR("No available command buffers!");
		return NULL;
	}

	if (remaining != hdr->param_len) {
		LOG_ERR("Command payload length is not correct");
		net_buf_unref(buf);
		return NULL;
	}

	LOG_DBG("len %u", hdr->param_len);
	net_buf_add_mem(buf, data, remaining);

	return buf;
}

static struct net_buf *hci_rpmsg_acl_recv(uint8_t *data, size_t remaining)
{
	struct bt_hci_acl_hdr *hdr = (void *)data;
	struct net_buf *buf;

	if (remaining < sizeof(*hdr)) {
		LOG_ERR("Not enought data for ACL header");
		return NULL;
	}

	buf = bt_buf_get_tx(BT_BUF_ACL_OUT, K_NO_WAIT, hdr, sizeof(*hdr));
	if (buf) {
		data += sizeof(*hdr);
		remaining -= sizeof(*hdr);
	} else {
		LOG_ERR("No available ACL buffers!");
		return NULL;
	}

	if (remaining != sys_le16_to_cpu(hdr->len)) {
		LOG_ERR("ACL payload length is not correct");
		net_buf_unref(buf);
		return NULL;
	}

	LOG_DBG("len %u", remaining);
	net_buf_add_mem(buf, data, remaining);

	return buf;
}

static struct net_buf *hci_rpmsg_iso_recv(uint8_t *data, size_t remaining)
{
	struct bt_hci_iso_hdr *hdr = (void *)data;
	struct net_buf *buf;

	if (remaining < sizeof(*hdr)) {
		LOG_ERR("Not enough data for ISO header");
		return NULL;
	}

	buf = bt_buf_get_tx(BT_BUF_ISO_OUT, K_NO_WAIT, hdr, sizeof(*hdr));
	if (buf) {
		data += sizeof(*hdr);
		remaining -= sizeof(*hdr);
	} else {
		LOG_ERR("No available ISO buffers!");
		return NULL;
	}

	if (remaining != sys_le16_to_cpu(hdr->len)) {
		LOG_ERR("ISO payload length is not correct");
		net_buf_unref(buf);
		return NULL;
	}

	LOG_DBG("len %zu", remaining);
	net_buf_add_mem(buf, data, remaining);

	return buf;
}

static void hci_rpmsg_rx(uint8_t *data, size_t len)
{
	uint8_t pkt_indicator;
	struct net_buf *buf = NULL;
	size_t remaining = len;

	LOG_HEXDUMP_DBG(data, len, "RPMSG data:");

	pkt_indicator = *data++;
	remaining -= sizeof(pkt_indicator);

	switch (pkt_indicator) {
	case HCI_RPMSG_CMD:
		buf = hci_rpmsg_cmd_recv(data, remaining);
		break;

	case HCI_RPMSG_ACL:
		buf = hci_rpmsg_acl_recv(data, remaining);
		break;

	case HCI_RPMSG_ISO:
		buf = hci_rpmsg_iso_recv(data, remaining);
		break;

	default:
		LOG_ERR("Unknown HCI type %u", pkt_indicator);
		return;
	}

	if (buf) {
		net_buf_put(&tx_queue, buf);

		LOG_HEXDUMP_DBG(buf->data, buf->len, "Final net buffer:");
	}
}

static void tx_thread(void *p1, void *p2, void *p3)
{
	while (1) {
		struct net_buf *buf;
		int err;

		/* Wait until a buffer is available */
		buf = net_buf_get(&tx_queue, K_FOREVER);
		/* Pass buffer to the stack */
		err = bt_send(buf);
		if (err) {
			LOG_ERR("Unable to send (err %d)", err);
			net_buf_unref(buf);
		}

		/* Give other threads a chance to run if tx_queue keeps getting
		 * new data all the time.
		 */
		k_yield();
	}
}

static int hci_rpmsg_send(struct net_buf *buf)
{
	uint8_t pkt_indicator;

	LOG_DBG("buf %p type %u len %u", buf, bt_buf_get_type(buf),
		buf->len);

	LOG_HEXDUMP_DBG(buf->data, buf->len, "Controller buffer:");

	switch (bt_buf_get_type(buf)) {
	case BT_BUF_ACL_IN:
		pkt_indicator = HCI_RPMSG_ACL;
		break;
	case BT_BUF_EVT:
		pkt_indicator = HCI_RPMSG_EVT;
		break;
	case BT_BUF_ISO_IN:
		pkt_indicator = HCI_RPMSG_ISO;
		break;
	default:
		LOG_ERR("Unknown type %u", bt_buf_get_type(buf));
		net_buf_unref(buf);
		return -EINVAL;
	}
	net_buf_push_u8(buf, pkt_indicator);

	LOG_HEXDUMP_DBG(buf->data, buf->len, "Final HCI buffer:");
	rpmsg_service_send(endpoint_id, buf->data, buf->len);

	net_buf_unref(buf);

	return 0;
}

#if defined(CONFIG_BT_CTLR_ASSERT_HANDLER)
void bt_ctlr_assert_handle(char *file, uint32_t line)
{
	BT_ASSERT_MSG(false, "Controller assert in: %s at %d", file, line);
}
#endif /* CONFIG_BT_CTLR_ASSERT_HANDLER */

int endpoint_cb(struct rpmsg_endpoint *ept, void *data, size_t len, uint32_t src,
		void *priv)
{
	LOG_INF("Received message of %u bytes.", len);
	hci_rpmsg_rx((uint8_t *) data, len);

	return RPMSG_SUCCESS;
}

void bt_hci_rpmsg_loop(void)
{
	int err;

	/* incoming events and data from the controller */
	static K_FIFO_DEFINE(rx_queue);

	LOG_DBG("Start");

	/* Enable the raw interface, this will in turn open the HCI driver */
	bt_enable_raw(&rx_queue);

	/* Spawn the TX thread and start feeding commands and data to the
	 * controller
	 */
	k_thread_create(&tx_thread_data, tx_thread_stack,
			K_THREAD_STACK_SIZEOF(tx_thread_stack), tx_thread,
			NULL, NULL, NULL, K_PRIO_COOP(7), 0, K_NO_WAIT);
	k_thread_name_set(&tx_thread_data, "HCI rpmsg TX");

	while (1) {
		struct net_buf *buf;

		buf = net_buf_get(&rx_queue, K_FOREVER);
		err = hci_rpmsg_send(buf);
		if (err) {
			LOG_ERR("Failed to send (err %d)", err);
		}
	}
}

/* Make sure we register endpoint before RPMsg Service is initialized. */
int register_endpoint(const struct device *arg)
{
	int status;

	status = rpmsg_service_register_endpoint("nrf_bt_hci", endpoint_cb);

	if (status < 0) {
		LOG_ERR("Registering endpoint failed with %d", status);
		return status;
	}

	endpoint_id = status;

	return 0;
}

SYS_INIT(register_endpoint, POST_KERNEL, CONFIG_RPMSG_SERVICE_EP_REG_PRIORITY);
```

## src/bt_hci_rpmsg.h
```c
/**
 * @file bt_hci_rpmsg.h
 * @author Giuliano FRANCHETTO
 * @date 15 November 2021
 * 
 * @copyright @verbatim
 * Intellinium SAS, 2014-present
 * All Rights Reserved.
 *
 * NOTICE:  All information contained herein is, and remains
 * the property of Intellinium SAS and its suppliers,
 * if any.  The intellectual and technical concepts contained
 * herein are proprietary to Intellinium SAS
 * and its suppliers and may be covered by French and Foreign Patents,
 * patents in process, and are protected by trade secret or copyright law.
 * Dissemination of this information or reproduction of this material
 * is strictly forbidden unless prior written permission is obtained
 * from Intellinium SAS.
 * @endverbatim
 * 
 * @brief 
 **/

#ifndef BT_HCI_RPMSG_H
#define BT_HCI_RPMSG_H

void bt_hci_rpmsg_loop(void);

#endif /* BT_HCI_RPMSG_H */
```

## src/common_ids.h
```c
/**
 * @file main..c
 * @author Giuliano FRANCHETTO
 * @date 15 November 2021
 *
 * @copyright @verbatim
 * Intellinium SAS, 2014-present
 * All Rights Reserved.
 *
 * NOTICE:  All information contained herein is, and remains
 * the property of Intellinium SAS and its suppliers,
 * if any.  The intellectual and technical concepts contained
 * herein are proprietary to Intellinium SAS
 * and its suppliers and may be covered by French and Foreign Patents,
 * patents in process, and are protected by trade secret or copyright law.
 * Dissemination of this information or reproduction of this material
 * is strictly forbidden unless prior written permission is obtained
 * from Intellinium SAS.
 * @endverbatim
 *
 * @brief
 **/

#ifndef COMMON_IDS_H_
#define COMMON_IDS_H_

#ifdef __cplusplus
extern "C" {
#endif

enum rpc_command {
	RPC_COMMAND_TX_POWER = 0x01,
	RPC_COMMAND_TRANSMIT_PATTERN = 0x02,
	RPC_COMMAND_START_CHANNEL = 0x03,
	RPC_COMMAND_END_CHANNEL = 0x04,
	RPC_COMMAND_TIME_ON_CHANNEL = 0x05,
	RPC_COMMAND_CANCEL = 0x06,
	RPC_COMMAND_DATA_RATE = 0x07,
	RPC_COMMAND_START_TX_CARRIER = 0x08,
	RPC_COMMAND_START_TX_MOD_CARRIER = 0x09,
	RPC_COMMAND_START_TX_DC_MOD_CARRIER = 0x0A,
	RPC_COMMAND_START_RX_SWEEP = 0x0B,
	RPC_COMMAND_START_TX_SWEEP = 0x0C,
	RPC_COMMAND_START_RX = 0x0D,
};

#ifdef __cplusplus
}
#endif

#endif /* COMMON_IDS_H_ */
```

## src/radio_test.c
```c
/*
 * Copyright (c) 2020 Nordic Semiconductor ASA
 *
 * SPDX-License-Identifier: LicenseRef-Nordic-5-Clause
 */

#include "radio_test.h"

#include <string.h>
#include <hal/nrf_nvmc.h>
#include <hal/nrf_power.h>
#include <hal/nrf_rng.h>
#include <nrfx_timer.h>
#include <zephyr.h>

#if CONFIG_NRF21540_FEM
#include "nrf21540.h"
#endif

/* IEEE 802.15.4 default frequency. */
#define IEEE_DEFAULT_FREQ         (5)
/* Length on air of the LENGTH field. */
#define RADIO_LENGTH_LENGTH_FIELD (8UL)

/* Frequency calculation for a given channel in the IEEE 802.15.4 radio
 * mode.
 */
#define IEEE_FREQ_CALC(_channel) (IEEE_DEFAULT_FREQ + \
				 (IEEE_DEFAULT_FREQ * \
				 ((_channel) - IEEE_MIN_CHANNEL)))
/* Frequency calculation for a given channel. */
#define CHAN_TO_FREQ(_channel) (2400 + _channel)

/* Buffer for the radio TX packet */
static uint8_t tx_packet[RADIO_MAX_PAYLOAD_LEN];
/* Buffer for the radio RX packet. */
static uint8_t rx_packet[RADIO_MAX_PAYLOAD_LEN];
/* Number of transmitted packets. */
static uint32_t tx_packet_cnt;
/* Number of received packets with valid CRC. */
static uint32_t rx_packet_cnt;

/* Radio current channel (frequency). */
static uint8_t current_channel;

/* Timer used for channel sweeps and tx with duty cycle. */
static const nrfx_timer_t timer = NRFX_TIMER_INSTANCE(0);

static bool sweep_proccesing;


#if CONFIG_NRF21540_FEM
static struct radio_test_nrf21540 nrf21540;

static int nrf21540_configure(bool rx, nrf_radio_mode_t mode,
			      struct radio_test_nrf21540 *nrf21540)
{
	int err;

	/* nRF21540 is kept powered during sweeping */
	if (!sweep_proccesing) {
		err = nrf21540_power_up();
		if (err) {
			return err;
		}
	}

	if (nrf21540->active_delay == 0) {
		nrf21540->active_delay =
			nrf21540_default_active_delay_calculate(false, mode);
	}

	if (rx) {
		return nrf21540_rx_configure(NRF21540_EXECUTE_NOW,
					     nrf_radio_event_address_get(
						NRF_RADIO,
						NRF_RADIO_EVENT_DISABLED),
					     nrf21540->active_delay);
	}

	/* Sweeping is done from the interrupt context do not trigger SPI
	 * transfer in the interrupt.
	 */
	if ((nrf21540->gain != NRF21540_USE_DEFAULT_GAIN) &&
	    !sweep_proccesing) {
		err = nrf21540_tx_gain_set(nrf21540->gain);
		if (err) {
			return err;
		}
	}

	return nrf21540_tx_configure(NRF21540_EXECUTE_NOW,
				     nrf_radio_event_address_get(NRF_RADIO,
						NRF_RADIO_EVENT_DISABLED),
				     nrf21540->active_delay);
}
#endif /* CONFIG_NRF21540_FEM */

static uint8_t rnd8(void)
{
	nrf_rng_event_clear(NRF_RNG, NRF_RNG_EVENT_VALRDY);

	while (!nrf_rng_event_check(NRF_RNG, NRF_RNG_EVENT_VALRDY)) {
		/* Do nothing. */
	}
	return nrf_rng_random_value_get(NRF_RNG);
}

static void radio_channel_set(nrf_radio_mode_t mode, uint8_t channel)
{
#if CONFIG_HAS_HW_NRF_RADIO_IEEE802154
	if (mode == NRF_RADIO_MODE_IEEE802154_250KBIT) {
		if ((channel >= IEEE_MIN_CHANNEL) &&
			(channel <= IEEE_MAX_CHANNEL)) {
			nrf_radio_frequency_set(
				NRF_RADIO,
				CHAN_TO_FREQ(IEEE_FREQ_CALC(channel)));
		} else {
			nrf_radio_frequency_set(
				NRF_RADIO,
				CHAN_TO_FREQ(IEEE_DEFAULT_FREQ));
		}
	} else {
		nrf_radio_frequency_set(NRF_RADIO, CHAN_TO_FREQ(channel));
	}
#else
	nrf_radio_frequency_set(NRF_RADIO, CHAN_TO_FREQ(channel));
#endif /* CONFIG_HAS_HW_NRF_RADIO_IEEE802154 */
}

static void radio_config(nrf_radio_mode_t mode, enum transmit_pattern pattern)
{
	nrf_radio_packet_conf_t packet_conf;

	/* Reset Radio ramp-up time. */
	nrf_radio_modecnf0_set(NRF_RADIO, false, RADIO_MODECNF0_DTX_Center);
	nrf_radio_crc_configure(NRF_RADIO, RADIO_CRCCNF_LEN_Disabled,
				NRF_RADIO_CRC_ADDR_INCLUDE, 0);

	/* Set the device address 0 to use when transmitting. */
	nrf_radio_txaddress_set(NRF_RADIO, 0);
	/* Enable the device address 0 to use to select which addresses to
	 * receive
	 */
	nrf_radio_rxaddresses_set(NRF_RADIO, 1);

	/* Set the address according to the transmission pattern. */
	switch (pattern) {
	case TRANSMIT_PATTERN_RANDOM:
		nrf_radio_prefix0_set(NRF_RADIO, 0xAB);
		nrf_radio_base0_set(NRF_RADIO, 0xABABABAB);
		break;

	case TRANSMIT_PATTERN_11001100:
		nrf_radio_prefix0_set(NRF_RADIO, 0xCC);
		nrf_radio_base0_set(NRF_RADIO, 0xCCCCCCCC);
		break;

	case TRANSMIT_PATTERN_11110000:
		nrf_radio_prefix0_set(NRF_RADIO, 0x6A);
		nrf_radio_base0_set(NRF_RADIO, 0x58FE811B);
		break;

	default:
		return;
	}

	/* Packet configuration:
	 * payload length size = 8 bits,
	 * 0-byte static length, max 255-byte payload,
	 * 4-byte base address length (5-byte full address length),
	 * Bit 24: 1 Big endian,
	 * Bit 25: 1 Whitening enabled.
	 */
	memset(&packet_conf, 0, sizeof(packet_conf));
	packet_conf.lflen = RADIO_LENGTH_LENGTH_FIELD;
	packet_conf.maxlen = (sizeof(tx_packet) - 1);
	packet_conf.statlen = 0;
	packet_conf.balen = 4;
	packet_conf.big_endian = true;
	packet_conf.whiteen = true;

	switch (mode) {
#if CONFIG_HAS_HW_NRF_RADIO_IEEE802154
		case NRF_RADIO_MODE_IEEE802154_250KBIT:
		/* Packet configuration:
		 * S1 size = 0 bits,
		 * S0 size = 0 bytes,
		 * 32-bit preamble.
		 */
		packet_conf.plen = NRF_RADIO_PREAMBLE_LENGTH_32BIT_ZERO;
		packet_conf.maxlen = IEEE_MAX_PAYLOAD_LEN;
		packet_conf.balen = 0;
		packet_conf.big_endian = false;
		packet_conf.whiteen = false;

		/* Set fast ramp-up time. */
		nrf_radio_modecnf0_set(NRF_RADIO, true,
				       RADIO_MODECNF0_DTX_Center);
		break;
#endif /* CONFIG_HAS_HW_NRF_RADIO_IEEE802154 */

#if CONFIG_HAS_HW_NRF_RADIO_BLE_CODED
		case NRF_RADIO_MODE_BLE_LR500KBIT:
	case NRF_RADIO_MODE_BLE_LR125KBIT:
		/* Packet configuration:
		 * S1 size = 0 bits,
		 * S0 size = 0 bytes,
		 * 10-bit preamble.
		 */
		packet_conf.plen = NRF_RADIO_PREAMBLE_LENGTH_LONG_RANGE;
		packet_conf.maxlen = IEEE_MAX_PAYLOAD_LEN;
		packet_conf.cilen = 2;
		packet_conf.termlen = 3;
		packet_conf.big_endian = false;
		packet_conf.balen = 3;

		/* Set fast ramp-up time. */
		nrf_radio_modecnf0_set(NRF_RADIO, true,
				       RADIO_MODECNF0_DTX_Center);

		/* Set CRC length; CRC calculation does not include the address
		 * field.
		 */
		nrf_radio_crc_configure(NRF_RADIO, RADIO_CRCCNF_LEN_Three,
					NRF_RADIO_CRC_ADDR_SKIP, 0);
		break;

#endif /* CONFIG_HAS_HW_NRF_RADIO_BLE_CODED */

	case NRF_RADIO_MODE_BLE_2MBIT:
		/* Packet configuration:
		 * S1 size = 0 bits,
		 * S0 size = 0 bytes,
		 * 16-bit preamble.
		 */
		packet_conf.plen = NRF_RADIO_PREAMBLE_LENGTH_16BIT;
		break;

	default:
		/* Packet configuration:
		 * S1 size = 0 bits,
		 * S0 size = 0 bytes,
		 * 8-bit preamble.
		 */
		packet_conf.plen = NRF_RADIO_PREAMBLE_LENGTH_8BIT;
		break;
	}

	nrf_radio_packet_configure(NRF_RADIO, &packet_conf);
}

static void generate_modulated_rf_packet(uint8_t mode,
					 enum transmit_pattern pattern)
{
	radio_config(mode, pattern);

	/* One byte used for size, actual size is SIZE-1 */
#if CONFIG_HAS_HW_NRF_RADIO_IEEE802154
	if (mode == NRF_RADIO_MODE_IEEE802154_250KBIT) {
		tx_packet[0] = IEEE_MAX_PAYLOAD_LEN - 1;
	} else {
		tx_packet[0] = sizeof(tx_packet) - 1;
	}
#else
	tx_packet[0] = sizeof(tx_packet) - 1;
#endif /* CONFIG_HAS_HW_NRF_RADIO_IEEE802154 */

	/* Fill payload with random data. */
	for (uint8_t i = 0; i < sizeof(tx_packet) - 1; i++) {
		if (pattern == TRANSMIT_PATTERN_RANDOM) {
			tx_packet[i + 1] = rnd8();
		} else if (pattern == TRANSMIT_PATTERN_11001100) {
			tx_packet[i + 1] = 0xCC;
		} else if (pattern == TRANSMIT_PATTERN_11110000) {
			tx_packet[i + 1] = 0xF0;
		} else {
			/* Do nothing. */
		}
	}
	nrf_radio_packetptr_set(NRF_RADIO, tx_packet);
}

static void radio_disable(void)
{
	nrf_radio_shorts_set(NRF_RADIO, 0);
	nrf_radio_int_disable(NRF_RADIO, ~0);
	nrf_radio_event_clear(NRF_RADIO, NRF_RADIO_EVENT_DISABLED);

	nrf_radio_task_trigger(NRF_RADIO, NRF_RADIO_TASK_DISABLE);
	while (!nrf_radio_event_check(NRF_RADIO, NRF_RADIO_EVENT_DISABLED)) {
		/* Do nothing */
	}
	nrf_radio_event_clear(NRF_RADIO, NRF_RADIO_EVENT_DISABLED);

#if CONFIG_NRF21540_FEM
	(void) nrf21540_txrx_configuration_clear();
	(void) nrf21540_txrx_stop();

	/* Do not powerdown nRF21540 during sweeping. */
	if (!sweep_proccesing) {
		(void) nrf21540_power_down();
	}
#endif /* CONFIG_NRF21540_FEM */
}

static void radio_unmodulated_tx_carrier(uint8_t mode, uint8_t txpower, uint8_t channel)
{
	radio_disable();

	nrf_radio_mode_set(NRF_RADIO, mode);
	nrf_radio_shorts_enable(NRF_RADIO, NRF_RADIO_SHORT_READY_START_MASK);
	nrf_radio_txpower_set(NRF_RADIO, txpower);

	radio_channel_set(mode, channel);

#if CONFIG_NRF21540_FEM
	(void) nrf21540_configure(false, mode, &nrf21540);
#else
	nrf_radio_task_trigger(NRF_RADIO, NRF_RADIO_TASK_TXEN);
#endif /* CONFIG_NRF21540_FEM */
}

static void radio_modulated_tx_carrier(uint8_t mode, uint8_t txpower, uint8_t channel,
				       enum transmit_pattern pattern)
{
	radio_disable();
	generate_modulated_rf_packet(mode, pattern);

	switch (mode) {
#if CONFIG_HAS_HW_NRF_RADIO_IEEE802154 || CONFIG_HAS_HW_NRF_RADIO_BLE_CODED
		case NRF_RADIO_MODE_IEEE802154_250KBIT:
	case NRF_RADIO_MODE_BLE_LR125KBIT:
	case NRF_RADIO_MODE_BLE_LR500KBIT:
		nrf_radio_shorts_enable(NRF_RADIO,
					NRF_RADIO_SHORT_READY_START_MASK |
					NRF_RADIO_SHORT_PHYEND_START_MASK);
		break;

#endif /* CONFIG_HAS_HW_NRF_RADIO_IEEE802154 || CONFIG_HAS_HW_NRF_RADIO_BLE_CODED */

	case NRF_RADIO_MODE_BLE_1MBIT:
	case NRF_RADIO_MODE_BLE_2MBIT:
	case NRF_RADIO_MODE_NRF_1MBIT:
	case NRF_RADIO_MODE_NRF_2MBIT:
	default:
#if defined(RADIO_MODE_MODE_Nrf_250Kbit)
		case NRF_RADIO_MODE_NRF_250KBIT:
#endif /* defined(RADIO_MODE_MODE_Nrf_250Kbit) */
		nrf_radio_shorts_enable(NRF_RADIO,
					NRF_RADIO_SHORT_READY_START_MASK |
						NRF_RADIO_SHORT_END_START_MASK);
		break;
	}

	nrf_radio_mode_set(NRF_RADIO, mode);
	nrf_radio_txpower_set(NRF_RADIO, txpower);

	radio_channel_set(mode, channel);

	tx_packet_cnt = 0;

	nrf_radio_event_clear(NRF_RADIO, NRF_RADIO_EVENT_END);
	nrf_radio_int_enable(NRF_RADIO, NRF_RADIO_INT_END_MASK);

#if CONFIG_NRF21540_FEM
	(void) nrf21540_configure(false, mode, &nrf21540);
#else
	nrf_radio_task_trigger(NRF_RADIO, NRF_RADIO_TASK_TXEN);
#endif /* CONFIG_NRF21540_FEM */
	while (!nrf_radio_event_check(NRF_RADIO, NRF_RADIO_EVENT_END)) {
		/* Do nothing */
	}
}

static void radio_rx(uint8_t mode, uint8_t channel, enum transmit_pattern pattern)
{
	radio_disable();

	nrf_radio_mode_set(NRF_RADIO, mode);
	nrf_radio_shorts_enable(NRF_RADIO,
				NRF_RADIO_SHORT_READY_START_MASK |
					NRF_RADIO_SHORT_END_START_MASK);
	nrf_radio_packetptr_set(NRF_RADIO, rx_packet);

	radio_config(mode, pattern);
	radio_channel_set(mode, channel);

	rx_packet_cnt = 0;

	nrf_radio_int_enable(NRF_RADIO, NRF_RADIO_INT_CRCOK_MASK);

#if CONFIG_NRF21540_FEM
	(void) nrf21540_configure(true, mode, &nrf21540);
#else
	nrf_radio_task_trigger(NRF_RADIO, NRF_RADIO_TASK_RXEN);
#endif
}

static void radio_sweep_start(uint8_t channel, uint32_t delay_ms)
{
	current_channel = channel;

#if CONFIG_NRF21540_FEM
	(void) nrf21540_power_up();

	if (nrf21540.gain != NRF21540_USE_DEFAULT_GAIN) {
		(void) nrf21540_tx_gain_set(nrf21540.gain);
	}
#endif

	nrfx_timer_disable(&timer);
	nrf_timer_shorts_disable(timer.p_reg, ~0);
	nrf_timer_int_disable(timer.p_reg, ~0);

	nrfx_timer_extended_compare(&timer,
				    NRF_TIMER_CC_CHANNEL0,
				    nrfx_timer_ms_to_ticks(&timer, delay_ms),
				    NRF_TIMER_SHORT_COMPARE0_CLEAR_MASK,
				    true);

	nrfx_timer_clear(&timer);
	nrfx_timer_enable(&timer);
}

static void radio_modulated_tx_carrier_duty_cycle(uint8_t mode, uint8_t txpower,
						  uint8_t channel,
						  enum transmit_pattern pattern,
						  uint32_t duty_cycle)
{
	/* Lookup table with time per byte in each radio MODE
	 * Mapped per NRF_RADIO->MODE available on nRF5-series devices
	 */
	static const uint8_t time_in_us_per_byte[16] = {
		8, 4, 32, 8, 4, 64, 16, 0, 0, 0, 0, 0, 0, 0, 0, 32
	};

	/* 1 byte preamble, 5 byte address (BALEN + PREFIX),
	 * and sizeof(payload), no CRC
	 */
	const uint32_t total_payload_size     = 1 + 5 + sizeof(tx_packet);
	const uint32_t total_time_per_payload =
		time_in_us_per_byte[mode] * total_payload_size;

	/* Duty cycle = 100 * Time_on / (time_on + time_off),
	 * we need to calculate "time_off" for delay.
	 * In addition, the timer includes the "total_time_per_payload",
	 * so we need to add this to the total timer cycle.
	 */
	uint32_t delay_time = total_time_per_payload +
		((100 * total_time_per_payload -
			(total_time_per_payload * duty_cycle)) /
			duty_cycle);

	radio_disable();
	generate_modulated_rf_packet(mode, pattern);

	nrf_radio_mode_set(NRF_RADIO, mode);
	nrf_radio_shorts_enable(NRF_RADIO,
				NRF_RADIO_SHORT_READY_START_MASK |
					NRF_RADIO_SHORT_END_DISABLE_MASK);
	nrf_radio_txpower_set(NRF_RADIO, txpower);
	radio_channel_set(mode, channel);

#if CONFIG_NRF21540_FEM
	(void) nrf21540_power_up();

	if (nrf21540.gain != NRF21540_USE_DEFAULT_GAIN) {
		(void) nrf21540_tx_gain_set(nrf21540.gain);
	}

	if (nrf21540.active_delay == 0) {
		nrf21540.active_delay =
			nrf21540_default_active_delay_calculate(false, mode);
	}

#endif /* CONFIG_NRF21540_FEM */

	/* We let the TIMER start the radio transmission again. */
	nrfx_timer_disable(&timer);
	nrf_timer_shorts_disable(timer.p_reg, ~0);
	nrf_timer_int_disable(timer.p_reg, ~0);

	nrfx_timer_extended_compare(&timer,
				    NRF_TIMER_CC_CHANNEL1,
				    nrfx_timer_us_to_ticks(&timer, delay_time),
				    NRF_TIMER_SHORT_COMPARE1_CLEAR_MASK,
				    true);

	nrfx_timer_clear(&timer);
	nrfx_timer_enable(&timer);
}

void radio_test_start(const struct radio_test_config *config)
{
#if CONFIG_NRF21540_FEM
	nrf21540.active_delay = config->nrf21540.active_delay;
	nrf21540.gain = config->nrf21540.gain;
#endif

	switch (config->type) {
	case UNMODULATED_TX:
		radio_unmodulated_tx_carrier(config->mode,
					     config->params.unmodulated_tx.txpower,
					     config->params.unmodulated_tx.channel);
		break;
	case MODULATED_TX:
		radio_modulated_tx_carrier(config->mode,
					   config->params.modulated_tx.txpower,
					   config->params.modulated_tx.channel,
					   config->params.modulated_tx.pattern);
		break;
	case RX:
		radio_rx(config->mode,
			 config->params.rx.channel,
			 config->params.rx.pattern);
		break;
	case TX_SWEEP:
		radio_sweep_start(config->params.tx_sweep.channel_start,
				  config->params.tx_sweep.delay_ms);
		break;
	case RX_SWEEP:
		radio_sweep_start(config->params.rx_sweep.channel_start,
				  config->params.rx_sweep.delay_ms);
		break;
	case MODULATED_TX_DUTY_CYCLE:
		radio_modulated_tx_carrier_duty_cycle(config->mode,
						      config->params.modulated_tx_duty_cycle.txpower,
						      config->params.modulated_tx_duty_cycle.channel,
						      config->params.modulated_tx_duty_cycle.pattern,
						      config->params.modulated_tx_duty_cycle.duty_cycle);
		break;
	}
}

void radio_test_cancel(void)
{
	nrfx_timer_disable(&timer);
	radio_disable();
}

void radio_rx_stats_get(struct radio_rx_stats *rx_stats)
{
	size_t size;

#if CONFIG_HAS_HW_NRF_RADIO_IEEE802154
	nrf_radio_mode_t radio_mode;

	radio_mode = nrf_radio_mode_get(NRF_RADIO);
	if (radio_mode == NRF_RADIO_MODE_IEEE802154_250KBIT) {
		size = IEEE_MAX_PAYLOAD_LEN;
	} else {
		size = sizeof(rx_packet);
	}
#else
	size = sizeof(rx_packet);
#endif /* CONFIG_HAS_HW_NRF_RADIO_IEEE802154 */

	rx_stats->last_packet.buf = rx_packet;
	rx_stats->last_packet.len = size;
	rx_stats->packet_cnt = rx_packet_cnt;
}

#if NRF_POWER_HAS_DCDCEN_VDDH || NRF_POWER_HAS_DCDCEN
void toggle_dcdc_state(uint8_t dcdc_state)
{
	bool is_enabled;

#if NRF_POWER_HAS_DCDCEN_VDDH
	if (dcdc_state == 0) {
		is_enabled = nrf_power_dcdcen_vddh_get(NRF_POWER);
		nrf_power_dcdcen_vddh_set(NRF_POWER, !is_enabled);
		return;
	}
#endif /* NRF_POWER_HAS_DCDCEN_VDDH */

#if NRF_POWER_HAS_DCDCEN
	if (dcdc_state <= 1) {
		is_enabled = nrf_power_dcdcen_get(NRF_POWER);
		nrf_power_dcdcen_set(NRF_POWER, !is_enabled);
		return;
	}
#endif /* NRF_POWER_HAS_DCDCEN */
}
#endif /* NRF_POWER_HAS_DCDCEN_VDDH || NRF_POWER_HAS_DCDCEN */

static void timer_handler(nrf_timer_event_t event_type, void *context)
{
	const struct radio_test_config *config =
		(const struct radio_test_config *) context;

	if (event_type == NRF_TIMER_EVENT_COMPARE0) {
		uint8_t channel_start;
		uint8_t channel_end;

		if (config->type == TX_SWEEP) {
			sweep_proccesing = true;
			radio_unmodulated_tx_carrier(config->mode,
						     config->params.tx_sweep.txpower,
						     current_channel);

			channel_start = config->params.tx_sweep.channel_start;
			channel_end = config->params.tx_sweep.channel_end;
		} else if (config->type == RX_SWEEP) {
			sweep_proccesing = true;
			radio_rx(config->mode,
				 current_channel,
				 config->params.rx.pattern);

			channel_start = config->params.rx_sweep.channel_start;
			channel_end = config->params.rx_sweep.channel_end;
		} else {
			printk("Unexpected test type: %d\n", config->type);
			return;
		}

		sweep_proccesing = false;

		current_channel++;
		if (current_channel > channel_end) {
			current_channel = channel_start;
		}
	}

	if (event_type == NRF_TIMER_EVENT_COMPARE1) {
#if CONFIG_NRF21540_FEM
		(void) nrf21540_txrx_configuration_clear();
		(void) nrf21540_txrx_stop();
		(void) nrf21540_tx_configure(NRF21540_EXECUTE_NOW,
				nrf_radio_event_address_get(NRF_RADIO,
						NRF_RADIO_EVENT_DISABLED),
				nrf21540.active_delay);
#else
		nrf_radio_task_trigger(NRF_RADIO, NRF_RADIO_TASK_TXEN);
#endif /* CONFIG_NRF21540_FEM */
	}
}

static void timer_init(const struct radio_test_config *config)
{
	nrfx_err_t          err;
	nrfx_timer_config_t timer_cfg = {
		.frequency = NRF_TIMER_FREQ_1MHz,
		.mode      = NRF_TIMER_MODE_TIMER,
		.bit_width = NRF_TIMER_BIT_WIDTH_24,
		.p_context = (void *) config,
	};

	err = nrfx_timer_init(&timer, &timer_cfg, timer_handler);
	if (err != NRFX_SUCCESS) {
		printk("nrfx_timer_init failed with: %d\n", err);
	}
}

void radio_handler(const void *context)
{
	const struct radio_test_config *config =
		(const struct radio_test_config *) context;

	if (nrf_radio_event_check(NRF_RADIO, NRF_RADIO_EVENT_CRCOK)) {
		nrf_radio_event_clear(NRF_RADIO, NRF_RADIO_EVENT_CRCOK);
		rx_packet_cnt++;
	}

	if (nrf_radio_event_check(NRF_RADIO, NRF_RADIO_EVENT_END)) {
		nrf_radio_event_clear(NRF_RADIO, NRF_RADIO_EVENT_END);

		tx_packet_cnt++;
		if (tx_packet_cnt == config->params.modulated_tx.packets_num) {
			radio_disable();
			config->params.modulated_tx.cb();
		}
	}
}

int radio_test_init(struct radio_test_config *config)
{
	nrf_rng_task_trigger(NRF_RNG, NRF_RNG_TASK_START);

#if CONFIG_NRF21540_FEM
	int err = nrf21540_init();

	if (err) {
		return err;
	}
#endif /* CONFIG_NRF21540_FEM */

	timer_init(config);
	IRQ_CONNECT(TIMER0_IRQn, IRQ_PRIO_LOWEST,
		    nrfx_timer_0_irq_handler, NULL, 0);

	irq_connect_dynamic(RADIO_IRQn, IRQ_PRIO_LOWEST, radio_handler, config, 0);
	irq_enable(RADIO_IRQn);

	return 0;
}
```

## src/radio_test.h
```c
/*
 * Copyright (c) 2020 Nordic Semiconductor ASA
 *
 * SPDX-License-Identifier: LicenseRef-Nordic-5-Clause
 */

#ifndef RADIO_TEST_H_
#define RADIO_TEST_H_

#include <zephyr/types.h>
#include <hal/nrf_radio.h>

/** Maximum radio RX or TX payload. */
#define RADIO_MAX_PAYLOAD_LEN	256
/** IEEE 802.15.4 maximum payload length. */
#define IEEE_MAX_PAYLOAD_LEN	127
/** IEEE 802.15.4 minimum channel. */
#define IEEE_MIN_CHANNEL	11
/** IEEE 802.15.4 maximum channel. */
#define IEEE_MAX_CHANNEL	26

#define NRF21540_USE_DEFAULT_GAIN 0xFF

/**@brief Radio transmit and address pattern. */
enum transmit_pattern {
	/** Random pattern generated by RNG. */
	TRANSMIT_PATTERN_RANDOM = 0,

	/** Pattern 11110000(F0). */
	TRANSMIT_PATTERN_11110000 = 1,

	/** Pattern 11001100(CC). */
	TRANSMIT_PATTERN_11001100 = 2,
};

/**@brief Radio test mode. */
enum radio_test_mode {
	/** TX carrier. */
	UNMODULATED_TX,

	/** Modulated TX carrier. */
	MODULATED_TX,

	/** RX carrier. */
	RX,

	/** TX carrier sweep. */
	TX_SWEEP,

	/** RX carrier sweep. */
	RX_SWEEP,

	/** Duty-cycled modulated TX carrier. */
	MODULATED_TX_DUTY_CYCLE,
};

/**@brief Radio test nRF21540 configuration */
struct radio_test_nrf21540 {
	/* nRF21540 activation delay. */
	uint32_t active_delay;

	/* nRF21540 TX gain. */
	uint8_t gain;
};

/**@brief Radio test configuration. */
struct radio_test_config {
	/** Radio test type. */
	enum radio_test_mode type;

	/** Radio mode. Data rate and modulation. */
	nrf_radio_mode_t mode;

	union {
		struct {
			/** Radio output power. */
			uint8_t txpower;

			/** Radio channel. */
			uint8_t channel;
		} unmodulated_tx;

		struct {
			/** Radio output power. */
			uint8_t txpower;

			/** Radio transmission pattern. */
			enum transmit_pattern pattern;

			/** Radio channel. */
			uint8_t channel;

			/**
			 * Number of pacets to transmit.
			 * Set to zero for continuous TX.
			 */
			uint32_t packets_num;

			/** Callback to indicate that TX is finished. */
			void (*cb)(void);
		} modulated_tx;

		struct {
			/** Radio transmission pattern. */
			enum transmit_pattern pattern;

			/** Radio channel. */
			uint8_t channel;
		} rx;

		struct {
			/** Radio output power. */
			uint8_t txpower;

			/** Radio start channel (frequency). */
			uint8_t channel_start;

			/** Radio end channel (frequency). */
			uint8_t channel_end;

			/** Delay time in milliseconds. */
			uint32_t delay_ms;
		} tx_sweep;

		struct {
			/** Radio start channel (frequency). */
			uint8_t channel_start;

			/** Radio end channel (frequency). */
			uint8_t channel_end;

			/** Delay time in milliseconds. */
			uint32_t delay_ms;
		} rx_sweep;

		struct {
			/** Radio output power. */
			uint8_t txpower;

			/** Radio transmission pattern. */
			enum transmit_pattern pattern;

			/** Radio channel. */
			uint8_t channel;

			/** Duty cycle. */
			uint32_t duty_cycle;
		} modulated_tx_duty_cycle;
	} params;

#if CONFIG_NRF21540_FEM
	/* nRF21540 configuration. */
	struct radio_test_nrf21540 nrf21540;
#endif /* CONFIG_NRF21540_FEM */
};

/**@brief Radio RX statistics. */
struct radio_rx_stats {
	/** Content of the last packet. */
	struct {
		/** Content of the last packet. */
		uint8_t *buf;

		/** Length of the last packet. */
		size_t len;
	} last_packet;

	/** Number of received packets with valid CRC. */
	uint32_t packet_cnt;
};

/**
 * @brief Function for initializing the Radio Test module.
 *
 * @param[in] config  Radio test configuration.
 *
 * @retval 0 If the operation was successful.
 *           Otherwise, a (negative) error code is returned.
 */
int radio_test_init(struct radio_test_config *config);

/**
 * @brief Function for starting radio test.
 *
 * @param[in] config  Radio test configuration.
 */
void radio_test_start(const struct radio_test_config *config);

/**
 * @brief Function for stopping ongoing test (Radio and Timer operations).
 */
void radio_test_cancel(void);

/**
 * @brief Function for get RX statistics.
 *
 * @param[out] rx_stats RX statistics.
 */
void radio_rx_stats_get(struct radio_rx_stats *rx_stats);

/**
 * @brief Function for toggling the DC/DC converter state.
 *
 * @param[in] dcdc_state  DC/DC converter state.
 */
void toggle_dcdc_state(uint8_t dcdc_state);

#endif /* RADIO_TEST_H_ */
```
